// Phase 1: display bring-up and layout calibration.
//
// Shows the calibration page generated by bookprep (include/test_pages.h, the
// same bitmap format as .t5b pages) with a full refresh and prints timings.
//
//   USER short / 'g'  ghosting test: 30 partial updates alternating two text pages
//                     (step counter bottom right), 10 s pause, then 1 full refresh
//   USER long / 'r'   flip rotation 90 <-> 270 and redraw the calibration page
//   BOOT short / 'f'  redraw with a fast refresh (timing) if the panel has one
//   BOOT long / 'F'   redraw with a full refresh
// (BOOT only exists on V2.4 boards; the serial monitor works on all.)
//
// Check on the panel: border complete on all four sides, corner markers TL
// filled / TR hollow / BL triangle / BR cross, arrow pointing at the edge you
// call "top", and the staircase reading \\\\ (not ////).
#include <Arduino.h>

#include "board.h"
#include "button.h"
#include "display.h"
#include "test_pages.h"

namespace {

static_assert(kDevPageW == kPageW && kDevPageH == kPageH && kDevPageBytes == kPageBytes,
              "test_pages.h does not match the panel geometry; run `pixi run devpages`");

constexpr int kGhostSteps = 30;
constexpr uint32_t kGhostPauseMs = 10000;

int rotation = kEpdRotation;
ButtonTracker nextButton;
ButtonTracker menuButton;

const char *modeName(Refresh m) {
  switch (m) {
    case Refresh::Full: return "full";
    case Refresh::Fast: return "fast";
    case Refresh::Partial: return "partial";
  }
  return "?";
}

void report(const char *what, Refresh used) {
  const display::Timing t = display::lastTiming();
  Serial.printf("%-22s %-7s data %4u ms  refresh %4u ms\n", what, modeName(used),
                unsigned(t.dataMs), unsigned(t.refreshMs));
}

void showCalibration(Refresh mode) {
  memcpy(display::framebuffer(), kCalibrationPage, kPageBytes);
  report("calibration page", display::show(mode));
}

void drawStep(int step) {
  char text[16];
  snprintf(text, sizeof(text), " %2d/%d ", step, kGhostSteps);
  display::drawText6x8(text, kPageW - 6 * int(strlen(text)) - 2, kPageH - 9, BBEP_WHITE,
                       BBEP_BLACK);
}

void ghostingTest() {
  Serial.println("ghosting test: watch for remnants of the previous page");
  uint32_t sum = 0;
  for (int step = 1; step <= kGhostSteps; step++) {
    memcpy(display::framebuffer(), kSamplePages[step % kSamplePageCount], kPageBytes);
    drawStep(step);
    char label[24];
    snprintf(label, sizeof(label), "ghosting step %d", step);
    report(label, display::show(Refresh::Partial));
    sum += display::lastTiming().refreshMs;
  }
  Serial.printf("partial refresh average: %u ms\n", unsigned(sum / kGhostSteps));
  Serial.printf("pausing %u s: judge the ghosting now\n", unsigned(kGhostPauseMs / 1000));
  delay(kGhostPauseMs);
  report("full after ghosting", display::show(Refresh::Full));
}

void flipRotation() {
  rotation = rotation == 90 ? 270 : 90;
  display::setRotation(rotation);
  Serial.printf("rotation %d (set kEpdRotation in board.h to the upright one)\n", rotation);
  showCalibration(Refresh::Full);
}

void help() {
  Serial.println("USER short / g: ghosting test | USER long / r: flip rotation | "
                 "BOOT short / f: fast refresh | BOOT long / F: full refresh");
}

}  // namespace

void setup() {
  Serial.begin(115200);
  delay(300);
  pinMode(kBtnUser, INPUT);  // GPIO39: external pull-up only
  pinMode(kBtnBoot, INPUT_PULLUP);
  Serial.printf("\nT5 calibration, panel %d, rotation %d\n", kEpdPanel, rotation);
  display::begin();
  showCalibration(Refresh::Full);
  help();
}

void loop() {
  const uint32_t now = millis();
  const int cmd = Serial.available() ? Serial.read() : -1;
  if (cmd == 'g') ghostingTest();
  if (cmd == 'r') flipRotation();
  if (cmd == 'f') showCalibration(Refresh::Fast);
  if (cmd == 'F') showCalibration(Refresh::Full);
  if (cmd == '?') help();
  switch (nextButton.update(digitalRead(kBtnUser) == LOW, now)) {
    case ButtonEvent::Short:
      ghostingTest();
      break;
    case ButtonEvent::Long:
      flipRotation();
      break;
    default:
      break;
  }
  switch (menuButton.update(digitalRead(kBtnBoot) == LOW, now)) {
    case ButtonEvent::Short:
      showCalibration(Refresh::Fast);
      break;
    case ButtonEvent::Long:
      showCalibration(Refresh::Full);
      break;
    default:
      break;
  }
  delay(5);
}
